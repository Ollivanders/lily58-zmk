## boards/shields/sixbysix_dongle/Kconfig.shield
```kconfig
# No whitespace after the comma or in the keyboard name!
config SHIELD_SIXBYSIX_DONGLE
    def_bool $(shields_list_contains,sixbysix_dongle)
```
